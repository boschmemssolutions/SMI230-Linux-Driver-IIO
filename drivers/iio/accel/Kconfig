## drivers/iio/accel/Kconfig
```kconfig
menu "Accelerometers"

config SMI230_ACC
	tristate "Bosch Sensor SMI230 Accelerometer"
	depends on (I2C || SPI_MASTER)
	select IIO_BUFFER
	select IIO_TRIGGERED_BUFFER
	help
	  Build driver for Bosch SMI230 tri-axis accelerometer sensor.

choice
	prompt "Select communication interface"
	depends on SMI230_ACC
	help
	  Note: SPI and I2C are not supported at the same time, that is to say:
	  Choose either SPI or I2C to build the driver.

    config SMI230_ACC_SPI
		bool "Enable SPI connection"
		depends on SPI_MASTER

    config SMI230_ACC_I2C
		bool "Enable I2C connection"
		depends on I2C
endchoice

choice
	prompt "Select operating mode"
	depends on SMI230_ACC
	default SMI230_ACC_DATA_RDY
	help
	  New Data:  interrupt when new acceleration data is available.
	  FIFO:      use hardware fifo and issue interrupt on specific fill level.
	  Data Sync: synchronize data between SMI230 accelerometer and gyro.

	config SMI230_ACC_DATA_RDY
		bool "New data mode"
	config SMI230_ACC_FIFO
		bool "FIFO mode"
	config SMI230_ACC_DATA_SYNC
		bool "Data Sync mode"
endchoice

choice
	prompt "Select ACC FIFO interrupt type"
	depends on SMI230_ACC && SMI230_ACC_FIFO

    config SMI230_ACC_FIFO_WM
		bool "use watermark threshold to generate interrupt"

    config SMI230_ACC_FIFO_FULL
		bool "generate interrupt when FIFO is full"
endchoice

choice
	prompt "Select interrupt source"
	depends on SMI230_ACC
	default SMI230_ACC_INT2

    config SMI230_ACC_INT1
		depends on !SMI230_ACC_DATA_SYNC
		bool "use int1 as source"
		help
		  This enables INT1 as source for ACC, due to development board hardware design, the int1 pin is not for datasync mode

    config SMI230_ACC_INT2
		bool "use int2 as source"
		help
	 	  This enables INT2 as source for ACC
endchoice

choice
	prompt "Select interrupt behaviour"
	depends on SMI230_ACC
	default SMI230_ACC_PUSH_PULL
	
	config SMI230_ACC_PUSH_PULL
		bool "push-pull mode"
		help
		  Use push-pull mode for interrupt pin.
		  
	config SMI230_ACC_OPEN_DRAIN
		bool "open-drain mode"
		help
		  Use open-drain mode for interrupt pin. Pull-up resistor needed!
endchoice

choice
	prompt "Select ACC interrupt level"
	depends on SMI230_ACC
	default SMI230_ACC_ACTIVE_HIGH
	
	config SMI230_ACC_ACTIVE_LOW
		bool "active low"
		help
		  Interrupt signal is active low or falling edge.
		  
	config SMI230_ACC_ACTIVE_HIGH
		bool "active high"
		help
		  Interrupt signal is active high or rising edge.
endchoice

config SMI230_ACC_MAX_BUFFER_LEN
	depends on SMI230_ACC
	int "configue read buffer size"
	default "1024"
	help
	  Considering using FIFO, 1024 bytes are big enough for most cases. Do not change this value if not sure.

endmenu
```

## drivers/iio/gyro/Kconfig
```kconfig
menu "Digital gyroscope sensors"

config SMI230_GYRO
	tristate "BOSCH SMI230 Gyro Sensor"
	depends on (I2C || SPI_MASTER)
	select IIO_BUFFER
	select IIO_TRIGGERED_BUFFER
	help
	  Say yes here to build support for BOSCH SMI230GYRO Tri-axis Gyro Sensor
	  driver connected via I2C or SPI.

choice
        prompt "Select communication interface"
        depends on SMI230_GYRO
        help
          Note: SPI and I2C are not supported at the same time, that is to say:
          Choose either SPI or I2C to build the driver.

    config SMI230_GYRO_SPI
        bool "Enable SPI connection"
        depends on SPI_MASTER
    config SMI230_GYRO_I2C
        bool "Enable I2C connection"
        depends on I2C
endchoice

choice
        prompt "Select working mode"
        depends on SMI230_GYRO

    config SMI230_GYRO_NEW_DATA
        bool "New data"
        help
		interrupt comes once new data is available
    config SMI230_GYRO_FIFO
        bool "FIFO"
        help
		interrupt comes once data reaches certain FIFO watermark or FIFO full
endchoice

choice
	prompt "Select GYRO interrupt source"
	depends on (!SMI230_DATA_SYNC) && SMI230_GYRO
	default SMI230_GYRO_INT4

    config SMI230_GYRO_INT3
	bool "use int3 as source"

    config SMI230_GYRO_INT4
	bool "use int4 as source"
endchoice

choice
	prompt "Select GYRO interrupt edge"
	depends on (!SMI230_DATA_SYNC) && SMI230_GYRO
	default SMI230_GYRO_INT_ACTIVE_HIGH

    config SMI230_GYRO_INT_ACTIVE_HIGH
	bool "interrupt is on raising edge"

    config SMI230_GYRO_INT_ACTIVE_LOW
	bool "interrupt is on falling edge"

endchoice

config SMI230_MAX_BUFFER_LEN
        int "configue read buffer size"
        default "1024"
        help
          Considering using FIFO, 1024 bytes are big enough for most cases. Do not change this value if not sure.

endmenu
```

## drivers/iio/imu/smi230/Kconfig
```kconfig
config SMI230
	tristate "Bosch Sensor SMI230 Inertial Measurement Unit"
	depends on (I2C || SPI)
	select IIO_BUFFER
	select IIO_TRIGGERED_BUFFER
	help
	  Build driver for Bosch SMI230 sensor.

if SMI230

choice
	prompt "Select communication interface"
	help
	  Note: SPI, I2C are not supported at the same time, that is to say:
	  Choose either SPI, or I2C to build the driver.

	config SMI230_SPI
		bool "Enable SPI connection"
		depends on SPI_MASTER
		select REGMAP_SPI
	config SMI230_I2C
		bool "Enable I2C connection"
		depends on I2C
		select REGMAP_I2C
endchoice

choice
	prompt "Select interrupt operation mode"
	help
	  Note: data-ready, fifo-full and fifo-wm are not supported at the same time, that is to say:
	  Choose one of the three operation modes to build the driver.
	default SMI230_DATA_READY

	config SMI230_DATA_READY
		bool "Enable data-ready interrupt"
		
	config SMI230_FIFO_FULL
		bool "Enable fifo-full interrupt"

	config SMI230_FIFO_WM
		bool "Enable fifo-wm interrupt"

	config SMI230_DATA_SYNC
		bool "Enable data-sync interrupt"	
endchoice

choice
	prompt "Select ACC interrupt ouput pin"
	depends on SMI230 && !SMI230_DATA_SYNC
	default SMI230_ACC_INT2

    config SMI230_ACC_INT1
		bool "use int1 as interrupt ouput"
		help
	 	  This maps the ACC interrupt to int1

    config SMI230_ACC_INT2
		bool "use int2 as interrupt ouput"
		help
	 	  This maps the ACC interrupt to int2
endchoice

choice
	prompt "Select GYRO interrupt ouput pin"
	depends on SMI230 && !SMI230_DATA_SYNC
	default SMI230_GYRO_INT4

    config SMI230_GYRO_INT3
		bool "use int3 as source"
		help
	 	  This maps the GYRO interrupt to int3

    config SMI230_GYRO_INT4
		bool "use int4 as source"
		help
	 	  This maps the GYRO interrupt to int4
endchoice

choice
	prompt "Interrupt Features"
	depends on SMI230 
	default SMI230_INT_FEATURE_OFF

    config SMI230_INT_FEATURE_ON
		bool "activate interrupt features"
		help
	 	  This maps the FW interrupt to int2

    config SMI230_INT_FEATURE_OFF
		bool "deactivate interrupt features"
		
endchoice

endif  # SMI230
```
